## boards/shields/dfrobot_sen0232/Kconfig.defconfig
```kconfig
# Copyright (c) 2021 Henrik Brix Andersen <henrik@brixandersen.dk>
# SPDX-License-Identifier: Apache-2.0

if SHIELD_DFROBOT_SEN0232

config ADC
	default y

config SENSOR
	default y

config DFROBOT_SEN0232
	default y

endif # SHIELD_DFROBOT_SEN0232
```

## boards/shields/dfrobot_sen0232/Kconfig.shield
```kconfig
# Copyright (c) 2021 Henrik Brix Andersen <henrik@brixandersen.dk>
# SPDX-License-Identifier: Apache-2.0

config SHIELD_DFROBOT_SEN0232
	def_bool $(shields_list_contains,dfrobot_sen0232)
```

## drivers/sensor/dfrobot_sen0232/Kconfig
```kconfig
# DFRobot SEN0232 Sound Pressure Meter configuration options

# Copyright (c) 2021 Henrik Brix Andersen <henrik@brixandersen.dk>
# SPDX-License-Identifier: Apache-2.0

config DFROBOT_SEN0232
	bool "DFRobot Sound Pressure Meter"
	depends on ADC
	help
	  Enable driver for the DFRobot SEN0232 Sound Pressure Meter.

config DFROBOT_SEN0232_RESOLUTION
	int "ADC resolution"
	depends on DFROBOT_SEN0232
	default 10 if HAS_HW_NRF_ADC
	default 12 if HAS_MCUX_ADC12
	default 14 if HAS_HW_NRF_SAADC
	default 16 if HAS_MCUX_ADC16
	help
	  ADC resolution to use for the sound pressure level sensor
	  voltage readings.
```

## dts/bindings/sensor/dfrobot,sen0232.yaml
```yaml
# Copyright (c) 2021 Henrik Brix Andersen <henrik@brixandersen.dk>
# SPDX-License-Identifier: Apache-2.0

description: DFRobot SEN0232 Sound Level Meter

compatible: "dfrobot,sen0232"

include: base.yaml

properties:
  io-channels:
    required: true
    description: |
      ADC channel connected to the sound level meter output.

  reference-voltage:
    type: int
    required: true
    description: |
      ADC reference voltage in millivolts.
```
