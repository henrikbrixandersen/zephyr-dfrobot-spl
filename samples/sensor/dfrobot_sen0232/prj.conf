## CMakeLists.txt
```
# Copyright (c) 2021 Henrik Brix Andersen <henrik@brixandersen.dk>
# SPDX-License-Identifier: Apache-2.0

cmake_minimum_required(VERSION 3.13.1)

find_package(Zephyr REQUIRED HINTS $ENV{ZEPHYR_BASE})
project(dfrobot_sen0232)

FILE(GLOB app_sources src/*.c)
target_sources(app PRIVATE ${app_sources})
```

## prj.conf
```kconfig
CONFIG_CBPRINTF_FP_SUPPORT=y
CONFIG_LOG=y

CONFIG_ADC=y
CONFIG_SENSOR=y
CONFIG_DFROBOT_SEN0232=y
```

## boards/frdm_k64f.overlay
```dts
/*
 * Copyright (c) 2021 Henrik Brix Andersen <henrik@brixandersen.dk>
 *
 * SPDX-License-Identifier: Apache-2.0
 */

/ {
        dfrobot_sen0232: dfrobot_sen0232 {
                compatible = "dfrobot,sen0232";
		/* PTB10, J4 pin 6 */
                io-channels = <&adc1 14>;
                reference-voltage = <3300>;
        };
};

&adc1 {
	status = "okay";
};
```

## src/main.c
```c
/*
 * Copyright (c) 2021 Henrik Brix Andersen <henrik@brixandersen.dk>
 *
 * SPDX-License-Identifier: Apache-2.0
 */

#include <zephyr.h>
#include <device.h>
#include <drivers/sensor.h>
#include <drivers/sensor/dfrobot_sen0232.h>
#include <logging/log.h>
#include <stdio.h>

LOG_MODULE_REGISTER(main, CONFIG_LOG_DEFAULT_LEVEL);

/* Sound pressure level sample interval */
#define SAMPLE_INTERVAL K_MSEC(125)

void main(void)
{
	const struct device *dev = DEVICE_DT_GET(DT_INST(0, dfrobot_sen0232));
	struct sensor_value val;
	int err;

	if (!device_is_ready(dev)) {
		LOG_ERR("dfrobot sen0232 device not ready");
		return;
	}

	while (true) {
		k_sleep(SAMPLE_INTERVAL);

		err = sensor_sample_fetch(dev);
		if (err) {
			LOG_ERR("failed to fetch sensor sample (err %d)", err);
			continue;
		}

		err = sensor_channel_get(dev, SENSOR_CHAN_SOUND_PRESSURE_LEVEL_DBA,
					 &val);
		if (err) {
			LOG_ERR("failed to get sensor sample (err %d)", err);
			continue;
		}

		printf("Sound Level (LAF): %.03f dB(A)\n",
			sensor_value_to_double(&val));
	}
}
```
